#include "ssd1306.h"
#include <string.h>

static I2C_HandleTypeDef *i2c;
static uint8_t framebuf[SSD1306_WIDTH * SSD1306_HEIGHT / 8U];
static uint8_t cursor_x;
static uint8_t cursor_y;

static const uint8_t font5x7[][5] = {
    {0x00,0x00,0x00,0x00,0x00}, {0x00,0x00,0x5F,0x00,0x00},
    {0x00,0x07,0x00,0x07,0x00}, {0x14,0x7F,0x14,0x7F,0x14},
    {0x24,0x2A,0x7F,0x2A,0x12}, {0x23,0x13,0x08,0x64,0x62},
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    {0x08,0x08,0x2A,0x1C,0x08}
};

static HAL_StatusTypeDef ssd1306_cmd(uint8_t c)
{
    uint8_t buf[2] = { 0x00U, c };
    return HAL_I2C_Master_Transmit(i2c, SSD1306_ADDR, buf, 2U, 10U);
}

HAL_StatusTypeDef SSD1306_Init(I2C_HandleTypeDef *hi2c)
{
    i2c = hi2c;
    HAL_Delay(100U);

    if (HAL_I2C_IsDeviceReady(i2c, SSD1306_ADDR, 3U, 100U) != HAL_OK)
        return HAL_ERROR;

    if (ssd1306_cmd(0xAE) != HAL_OK) return HAL_ERROR;
    if (ssd1306_cmd(0xD5) != HAL_OK) return HAL_ERROR;
    if (ssd1306_cmd(0x80) != HAL_OK) return HAL_ERROR;
    if (ssd1306_cmd(0xA8) != HAL_OK) return HAL_ERROR;
    if (ssd1306_cmd(0x3F) != HAL_OK) return HAL_ERROR;
    if (ssd1306_cmd(0xD3) != HAL_OK) return HAL_ERROR;
    if (ssd1306_cmd(0x00) != HAL_OK) return HAL_ERROR;
    if (ssd1306_cmd(0x40) != HAL_OK) return HAL_ERROR;
    if (ssd1306_cmd(0x8D) != HAL_OK) return HAL_ERROR;
    if (ssd1306_cmd(0x14) != HAL_OK) return HAL_ERROR;
    if (ssd1306_cmd(0x20) != HAL_OK) return HAL_ERROR;
    if (ssd1306_cmd(0x00) != HAL_OK) return HAL_ERROR;
    if (ssd1306_cmd(0xA1) != HAL_OK) return HAL_ERROR;
    if (ssd1306_cmd(0xC8) != HAL_OK) return HAL_ERROR;
    if (ssd1306_cmd(0xDA) != HAL_OK) return HAL_ERROR;
    if (ssd1306_cmd(0x12) != HAL_OK) return HAL_ERROR;
    if (ssd1306_cmd(0x81) != HAL_OK) return HAL_ERROR;
    if (ssd1306_cmd(0xCF) != HAL_OK) return HAL_ERROR;
    if (ssd1306_cmd(0xD9) != HAL_OK) return HAL_ERROR;
    if (ssd1306_cmd(0xF1) != HAL_OK) return HAL_ERROR;
    if (ssd1306_cmd(0xDB) != HAL_OK) return HAL_ERROR;
    if (ssd1306_cmd(0x40) != HAL_OK) return HAL_ERROR;
    if (ssd1306_cmd(0xA4) != HAL_OK) return HAL_ERROR;
    if (ssd1306_cmd(0xA6) != HAL_OK) return HAL_ERROR;
    if (ssd1306_cmd(0xAF) != HAL_OK) return HAL_ERROR;

    SSD1306_Clear();
    SSD1306_Update();
    return HAL_OK;
}

void SSD1306_Clear(void)
{
    memset(framebuf, 0, sizeof(framebuf));
    cursor_x = 0U;
    cursor_y = 0U;
}

void SSD1306_SetCursor(uint8_t x, uint8_t y)
{
    cursor_x = x;
    cursor_y = y;
}

static void draw_char(uint8_t x, uint8_t page, char c)
{
    const uint8_t *glyph;
    uint8_t col;
    uint16_t idx;

    if ((c < 32) || (c > 126))
        c = '?';

    glyph = font5x7[c - 32];
    for (col = 0U; col < 5U; col++)
    {
        idx = (uint16_t)page * SSD1306_WIDTH + x + col;
        if (idx < sizeof(framebuf))
            framebuf[idx] = glyph[col];
    }

    idx = (uint16_t)page * SSD1306_WIDTH + x + 5U;
    if (idx < sizeof(framebuf))
        framebuf[idx] = 0x00U;
}

void SSD1306_WriteString(const char *str)
{
    while (*str != '\0')
    {
        if ((cursor_x + 6U) > SSD1306_WIDTH)
        {
            cursor_x = 0U;
            cursor_y++;
        }
        if (cursor_y >= 8U)
            break;

        draw_char(cursor_x, cursor_y, *str);
        cursor_x = (uint8_t)(cursor_x + 6U);
        str++;
    }
}

void SSD1306_Update(void)
{
    uint16_t i;

    ssd1306_cmd(0x21); ssd1306_cmd(0x00); ssd1306_cmd(127U);
    ssd1306_cmd(0x22); ssd1306_cmd(0x00); ssd1306_cmd(7U);

    for (i = 0U; i < sizeof(framebuf); i += 128U)
    {
        uint8_t buf[129];
        uint16_t chunk = (uint16_t)(sizeof(framebuf) - i);

        if (chunk > 128U)
            chunk = 128U;

        buf[0] = 0x40U;
        memcpy(&buf[1], &framebuf[i], chunk);
        HAL_I2C_Master_Transmit(i2c, SSD1306_ADDR, buf, chunk + 1U, 50U);
    }
}
